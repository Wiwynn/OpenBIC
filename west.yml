## west.yml
```yaml
manifest:
  remotes:
    - name: aspeed
      url-base: https://github.com/AspeedTech-BMC

  # Please add items below based on alphabetical order.
  # These dependencies may need updating if new features are added to the firmware.
  projects:
    - name: zephyr
      remote: aspeed
      path: zephyr
      revision: 9a1862443d1440e43f03384fe30c1ca48abd20ce
      import: 
        name-allowlist:
          - cmsis
          - mcuboot

  self:
    path: openbic
```
