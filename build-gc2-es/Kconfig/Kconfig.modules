## build-gc2-es/Kconfig/Kconfig.modules
```kconfig
menu "mbedtls (/mnt/data/home/pablo1997/MyAllProject/ZephyrOpenbic/TestGc2Bic_0102/modules/crypto/mbedtls)"
osource "$(ZEPHYR_MBEDTLS_KCONFIG)"
config ZEPHYR_MBEDTLS_MODULE
	bool
	default y
endmenu
```

## build-gc2-es/Kconfig/Kconfig.soc
```kconfig
osource "/home/pablo1997/MyAllProject/ZephyrOpenbic/TestGc2Bic_0102/zephyr/soc/$(ARCH)/*/Kconfig.soc"
```
